/*
 * boot.lds - PE32+ EFI application layout.
 *
 * The image is linked at 0x10000000 and each section is page aligned, as the
 * PE loader expects.  The .reloc section is generated by the PE linker from
 * the absolute references in .data (the GDT pointer), so firmware can load
 * the application at a different base if 0x10000000 is busy.
 */
ENTRY(efi_main)
SECTIONS
{
  . = 0x10001000;
  .text : { *(.text*) *(.rodata*) }

  . = ALIGN(0x1000);
  .data : { *(.data*) }

  . = ALIGN(0x1000);
  .bss  : { *(.bss*) *(COMMON) }

  /DISCARD/ : { *(.comment) *(.note*) *(.eh_frame*) *(.idata) }
}
